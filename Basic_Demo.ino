// Include application, user and local libraries
#include <dht.h>
#include "SPI.h"
#include "TFT_22_ILI9225.h"
#include <stdio.h>

#ifdef ARDUINO_ARCH_STM32F1
#define TFT_RST PA1
#define TFT_RS  PA2
#define TFT_CS  PA0 // SS
#define TFT_SDI PA7 // MOSI
#define TFT_CLK PA5 // SCK
#define TFT_LED 0 // 0 if wired to +5V directly
#elif defined(ESP8266)
#define TFT_RST 4   // D2
#define TFT_RS  5   // D1
#define TFT_CLK 14  // D5 SCK
//#define TFT_SDO 12  // D6 MISO
#define TFT_SDI 13  // D7 MOSI
#define TFT_CS  15  // D8 SS
#define TFT_LED 2   // D4     set 0 if wired to +5V directly -> D3=0 is not possible !!
#elif defined(ESP32)
#define TFT_RST 26  // IO 26
#define TFT_RS  25  // IO 25
#define TFT_CLK 14  // HSPI-SCK
//#define TFT_SDO 12  // HSPI-MISO
#define TFT_SDI 13  // HSPI-MOSI
#define TFT_CS  15  // HSPI-SS0
#define TFT_LED 0   // 0 if wired to +5V directly
SPIClass hspi(HSPI);
#else
#define TFT_RST 8
#define TFT_RS  9
#define TFT_CS  10  // SS
#define TFT_SDI 11  // MOSI
#define TFT_CLK 13  // SCK
#define TFT_LED 3   // 0 if wired to +5V directly
#endif
#define TFT_BRIGHTNESS 200 // Initial brightness of TFT backlight (optional)
#define DHT11_PIN 7
// Use hardware SPI (faster - on Uno: 13-SCK, 12-MISO, 11-MOSI)
TFT_22_ILI9225 tft = TFT_22_ILI9225(TFT_RST, TFT_RS, TFT_CS, TFT_LED, TFT_BRIGHTNESS);
// Use software SPI (slower)
//TFT_22_ILI9225 tft = TFT_22_ILI9225(TFT_RST, TFT_RS, TFT_CS, TFT_SDI, TFT_CLK, TFT_LED, TFT_BRIGHTNESS);
dht DHT;
// Variables and constants
uint16_t x, y;
boolean flag = false;

/*
 * Tux black/white image in 180x220 converted using Ardafruit bitmap converter
 * https://github.com/ehubin/Adafruit-GFX-Library/tree/master/Img2Code
 */
static const uint8_t PROGMEM tux[] = 
{
  0xff, 0xff, 0xff, 0xff, 0xff, 0xff, 0xff, 0xff, 0xff, 0xff, 0xff, 0xff, 0xff, 0xff, 0xff, 0xff, 0xff, 0xff, 0xff, 0xff, 0xff, 0xff, 
  0xff, 0xff, 0xff, 0xff, 0xff, 0xff, 0xff, 0xff, 0xff, 0xff, 0xff, 0xff, 0xff, 0xff, 0xff, 0xff, 0xff, 0xff, 0xff, 0xff, 0xff, 0xff, 
  0xff, 0xff, 0xff, 0xff, 0xff, 0xff, 0xff, 0xff, 0xff, 0xff, 0xff, 0xff, 0xff, 0xff, 0xff, 0xff, 0xff, 0xff, 0xff, 0xff, 0xff, 0xff, 
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  0xff, 0xff, 0xff, 0xff, 0xff, 0xff, 0xff, 0xff, 0xff, 0xff, 0xff, 0xff, 0xff, 0xff, 0xff, 0xff, 0xff, 0xff, 0xff, 0xff, 0xff, 0xff, 
};
static const uint8_t PROGMEM hello[] =
{
  0xff, 0xff, 0xff, 0xff, 0xff, 0xff, 0xff, 0xff, 0xff, 0xff, 0xff, 0xff, 0xff, 0xff, 0xff, 0xff, 0xff, 0xff, 0xff, 0xff, 0xff, 0xff, 
  0xff, 0xff, 0xff, 0xff, 0xff, 0xff, 0xff, 0xff, 0xff, 0xff, 0xff, 0xff, 0xff, 0xff, 0xff, 0xff, 0xff, 0xff, 0xff, 0xff, 0xff, 0xff, 
  0xff, 0xff, 0xff, 0xff, 0xff, 0xff, 0xff, 0xff, 0xff, 0xff, 0xff, 0xff, 0xff, 0xff, 0xff, 0xff, 0xff, 0xff, 0xff, 0xff, 0xff, 0xff, 
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  0xff, 0xff, 0xff, 0xff, 0xff, 0xff, 0xff, 0xff, 0xff, 0xff, 0xff, 0xff, 0xff, 0xff, 0xff, 0xff, 0xff, 0xff, 0xff, 0xff, 0xff, 0xff
};
static const uint8_t PROGMEM haha[] = 
{
  0xff, 0xff, 0xff, 0xff, 0xff, 0xff, 0xff, 0xff, 0xff, 0xfe, 
  0xff, 0xff, 0xff, 0xff, 0xdf, 0xff, 0xff, 0xff, 0xff, 0xfe, 
  0xff, 0xff, 0xff, 0xff, 0xd8, 0xff, 0xff, 0xff, 0xff, 0xfe, 
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  0xff, 0xff, 0xff, 0xff, 0xff, 0xff, 0xff, 0xff, 0xff, 0xfe, 
};
// Setup
void setup() {
#if defined(ESP32)
  hspi.begin();
  tft.begin(hspi);
#else
  tft.begin();
#endif
  Serial.begin(9600);
  Serial.println("Setup done");
}

// Loop
// 
//
//

#include <stdio.h>
#include <string.h>
int get_value(int *arrayhuh,int x,int y,int multiple){
  return *(arrayhuh +(multiple * x+y));
}
void change_value(int *arrayhuh,int x,int y, int multiple,int value){
  *(arrayhuh +(multiple * x+y)) = value;
}

int sales(int *arrayhuh, int *nope, int lengthi, int multiple){
  Serial.println("Start");
  // haha is the array that we're going to test
  int current_position_length = 0;
  // current_position_length is for nope
  // nope is the array that we're going twice as large as haha
  int current_position_subarray_length = 0;
  // current_position_subarray_length is for nope
  int haha_subarray_length = lengthi;
  int haha_length = lengthi;
  int nope_length = lengthi * multiple;

  Serial.println("Copy array");
  for(int i = 0;i < haha_length;i++){
    current_position_subarray_length = 0;
    for(int j = 0;j < haha_subarray_length;j++){
      for(int g = 0; g < multiple;g++){
        change_value(nope,current_position_length,current_position_subarray_length + g,nope_length,get_value(arrayhuh,i,j,lengthi));
      }
      //copying so that it would be twice as long
      current_position_subarray_length = current_position_subarray_length + multiple;
    }
    for(int l = 0;l < haha_subarray_length * multiple;l++){
      for(int p = 0;p < multiple;p++){
        change_value(nope,current_position_length + p,l,nope_length,get_value(nope,current_position_length,l,nope_length));
      }
    }
    //copying the previous line of array
    current_position_length = current_position_length + multiple;
    //increase current_position_length by 2
  }
  
  Serial.println("Dump array\n");
  for(int k = 0; k < nope_length; k++){
    for(int j = 0; j < nope_length; j++){
      if(get_value(nope, k, j, nope_length) == 0){
        tft.drawPixel(k,j, COLOR_WHITE);
      }
      else if(get_value(nope, k, j, nope_length) == 1){
        tft.drawPixel(k,j, COLOR_BLACK);
      }
    }
  }
  return 0;
}



void drawTemperature(char yeah[]){
  // temperature
  tft.setBackgroundColor(COLOR_BLACK);
  tft.drawBitmap(0, 0, haha, 79, 79, COLOR_WHITE);
  tft.setFont(Terminal12x16);
  tft.drawText(89, 10, yeah);
  delay(1500);
  tft.clear();
}
void drawPressure(char okok[]){
  tft.setFont(Terminal12x16);
  tft.drawText(10, 100, "Atmospheric");
  tft.drawText(10, 130, "Pressure:");
  tft.drawText(20, 150, okok);
  delay(3000);
  tft.clear();
}

void drawHumidity(char huh[]){
  haha[10];
  tft.setFont(Terminal12x16);
  tft.drawText(10, 100, "humidity");
  tft.drawText(20, 150, huh);
  delay(3000);
  tft.clear();
}

void drawTime(char good[]){
  tft.setBackgroundColor(COLOR_BLACK);
  tft.drawBitmap(0, 0, hello, 176, 220, COLOR_WHITE);
  tft.drawText(10, 100, good);
  delay(1500);
  tft.clear();
}
void loop() {
  /*
  DHT.read11(DHT11_PIN);
  char temperatureSTR[3];
  itoa(DHT.temperature,temperatureSTR , 10);
  drawTemperature(temperatureSTR);
  ///
  char humiditySTR[3];
  itoa(DHT.humidity,humiditySTR , 10);
  drawHumidity(humiditySTR);
  */

  tft.setBackgroundColor(COLOR_BLACK);
  int five[6][6] = {
    {1,0,0,0,1,1},
    {1,0,1,1,1,1},
    {1,0,0,0,1,1},
    {1,1,1,0,1,1},
    {1,1,1,0,1,1},
    {1,0,0,0,1,1}
  };
  
  int nope[50][50] = {};
  sales(*five,*nope,6,6);
  /*
  ///
  drawPressure("0.32165264");
  drawTime("23:59");
  
  //happy good
  tft.setBackgroundColor(COLOR_BLACK);
  tft.drawBitmap(0, 0, tux, 176, 220, COLOR_WHITE);
  */
  delay(1500);
  tft.clear();
}
